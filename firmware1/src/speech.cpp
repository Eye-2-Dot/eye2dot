/*
 * Eye 2 Dot — 펌웨어 1 (라벨 출력기)
 * speech.cpp — 오디오 출력 구현
 *
 * 타이머는 Arduino 함수(analogWrite, tone) 대신 레지스터로 직접 다룹니다.
 * analogWrite는 주파수를 고를 수 없고, tone은 Timer2를 통째로 가져가서
 * 우리가 쓸 8kHz 샘플 인터럽트를 만들 수 없기 때문입니다.
 */

#include <Arduino.h>
#include <avr/pgmspace.h>
#include <util/atomic.h>

#include "pins.h"
#include "speech.h"

// ─────────────────────────────────────────────
// 사인 테이블
//
// 값 = round(127.5 + 127.5 * sin(2*pi*i/256))
//   → 범위 0~255, 중심 128. 8비트 unsigned PCM과 같은 형식입니다.
//
// PROGMEM을 붙이면 플래시(256KB)에만 올라가고 RAM(8KB)은 쓰지 않습니다.
// 붙이지 않으면 부팅할 때 RAM으로 복사되어 256바이트를 잡아먹습니다.
// 나중에 오디오 버퍼를 잡아야 하므로 RAM은 아껴 둡니다.
//
// 읽을 때는 반드시 pgm_read_byte()를 써야 합니다.
// 그냥 배열처럼 접근하면 AVR은 같은 주소의 RAM을 읽어서 쓰레기 값이 나옵니다.
// ─────────────────────────────────────────────
static const uint8_t SINE_TABLE[256] PROGMEM = {
  128, 131, 134, 137, 140, 143, 146, 149, 152, 155, 158, 162, 165, 167, 170, 173,
  176, 179, 182, 185, 188, 190, 193, 196, 198, 201, 203, 206, 208, 211, 213, 215,
  218, 220, 222, 224, 226, 228, 230, 232, 234, 235, 237, 238, 240, 241, 243, 244,
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   79,  82,  85,  88,  90,  93,  97, 100, 103, 106, 109, 112, 115, 118, 121, 124,
};

// ─────────────────────────────────────────────
// 재생 상태
// ─────────────────────────────────────────────
enum SpeechState : uint8_t {
  SPEECH_STOPPED = 0,   // 무음
  SPEECH_DC      = 1,   // 고정값 출력 (ISR은 아무것도 하지 않음)
  SPEECH_TONE    = 2,   // 사인파 재생 (ISR이 매 샘플 OCR1A를 갱신)
};

// ─────────────────────────────────────────────
// ISR과 메인이 함께 쓰는 변수들
//
// volatile이 반드시 필요합니다.
// 없으면 컴파일러는 "이 변수는 이 함수 안에서 아무도 안 바꾸네"라고 판단해
// 레지스터에 캐싱하거나 조건문을 통째로 지워버립니다.
// ISR이 언제 끼어들어 값을 바꾸는지 컴파일러는 알 수 없기 때문입니다.
// ─────────────────────────────────────────────

// 위상 누산기 (16비트 고정소수점)
//   상위 8비트 = 테이블 인덱스 (0~255)
//   하위 8비트 = 소수부. 이것 덕분에 임의의 주파수를 낼 수 있습니다.
static volatile uint16_t phase = 0;

// 한 샘플마다 위상에 더할 양. 이 값이 곧 주파수입니다.
static volatile uint16_t phaseInc = 0;

static volatile SpeechState speechState = SPEECH_STOPPED;


// ─────────────────────────────────────────────
// speechInit() — 타이머 두 개를 설정합니다
// ─────────────────────────────────────────────
void speechInit() {
  // ── 출력 핀을 출력 모드로 ──
  // COM1A1만 켜고 이걸 빼먹으면 파형이 핀 밖으로 나가지 않습니다.
  // 소리가 아예 안 날 때 가장 먼저 의심할 부분입니다.
  //   핀 11 = PB5 이므로 DDRB의 5번 비트
  pinMode(PIN_AUDIO, OUTPUT);
  digitalWrite(PIN_AUDIO, LOW);

  // 설정하는 동안 인터럽트를 막아둡니다.
  // 레지스터를 반쯤 고친 상태에서 ISR이 돌면 엉뚱한 출력이 나옵니다.
  ATOMIC_BLOCK(ATOMIC_RESTORESTATE) {

    // ─────────────────────────────────────────
    // Timer1 — PWM 캐리어 (62.5kHz)
    //
    // 파형 모드: Fast PWM 8비트 → WGM13:10 = 0101
    //   WGM10 은 TCCR1A, WGM12 는 TCCR1B 에 있습니다.
    //   TOP = 255 로 고정되므로 샘플 값(0~255)을 그대로 OCR1A에 넣으면 됩니다.
    //
    // 출력 모드: COM1A1 = 1, COM1A0 = 0 → 비반전
    //   OCR1A 값이 클수록 HIGH 구간이 길어집니다 = 평균 전압이 높아집니다.
    //
    // 분주: CS12:10 = 001 → 분주 없음
    //
    // 캐리어 주파수 = F_CPU / (TOP + 1) = 16,000,000 / 256 = 62,500 Hz
    //   사람이 들을 수 있는 한계(약 20kHz)보다 훨씬 높아서
    //   캐리어 자체는 들리지 않고, RC 필터로 쉽게 깎아낼 수 있습니다.
    // ─────────────────────────────────────────
    TCCR1A = (1 << COM1A1) | (1 << WGM10);
    TCCR1B = (1 << WGM12)  | (1 << CS10);
    TCNT1  = 0;
    OCR1A  = SPEECH_SILENCE;   // 듀티비 50% = 무음

    // ─────────────────────────────────────────
    // Timer2 — 샘플 인터럽트 (8kHz)
    //
    // 파형 모드: CTC → WGM22:20 = 010 (WGM21만 1)
    //   TCNT2가 OCR2A에 닿으면 0으로 돌아가면서 인터럽트가 걸립니다.
    //
    // 분주: CS22:20 = 010 → 분주 8
    //
    // 인터럽트 주파수 = F_CPU / (분주 * (OCR2A + 1))
    //                = 16,000,000 / (8 * 250)
    //                = 8,000 Hz          ← 서버 샘플레이트와 정확히 일치
    //   나누어떨어져서 오차가 0입니다. 재생 속도가 밀리지 않습니다.
    //
    // 한 인터럽트 사이의 간격 = 125us = 2000 사이클.
    // ISR은 40사이클 남짓이라 CPU의 2% 정도만 씁니다.
    // ─────────────────────────────────────────
    TCCR2A = (1 << WGM21);
    TCCR2B = (1 << CS21);
    TCNT2  = 0;
    OCR2A  = 249;                // 250분주 (0부터 세므로 250-1)
    TIMSK2 = (1 << OCIE2A);      // OCR2A 일치 인터럽트 허용

    phase       = 0;
    phaseInc    = 0;
    speechState = SPEECH_STOPPED;
  }

  // Timer0 은 건드리지 않습니다.
  // millis(), micros(), delay() 가 Timer0 을 쓰기 때문에
  // 손대면 시간 관련 함수가 전부 망가집니다.

  sei();   // 전역 인터럽트 허용 (Arduino 프레임워크가 이미 켜두지만 확실히)
}


// ─────────────────────────────────────────────
// speechPlayTone() — 사인파 재생 시작
// ─────────────────────────────────────────────
void speechPlayTone(uint16_t freq) {
  // 범위 제한.
  // 4000Hz(나이퀴스트)를 넘으면 앨리어싱이 생겨
  // 의도한 것과 전혀 다른 낮은 음이 들립니다.
  if (freq == 0) {
    speechStop();
    return;
  }
  if (freq > SPEECH_MAX_FREQ) {
    freq = SPEECH_MAX_FREQ;
  }

  // ── 위상 증가량 계산 ──
  //
  // 한 바퀴(360도)를 65536으로 봅니다.
  // 1초에 freq 바퀴를 돌아야 하고, 1초에 8000번 갱신되므로
  //
  //   increment = 65536 * freq / 8000
  //
  //   440Hz  → 3604  (실제 440.06Hz, 오차 0.06Hz)
  //   1000Hz → 8192  (정확)
  //   220Hz  → 1802
  //
  // 부동소수점을 쓰지 않는 이유:
  //   AVR에는 FPU가 없어서 float 곱셈 하나에 수백 사이클이 걸립니다.
  //   ISR 예산이 2000 사이클인데 여기서 다 써버립니다.
  //   여기서는 정수 나눗셈을 메인 쪽에서 딱 한 번만 하고,
  //   ISR에는 덧셈과 시프트만 남깁니다.
  //
  // uint32_t 로 올리는 이유:
  //   4000 * 65536 = 262,144,000. uint16_t로는 한참 넘칩니다.
  uint16_t inc = (uint16_t)(((uint32_t)freq * 65536UL) / SPEECH_SAMPLE_RATE);

  // ── 원자적으로 반영 ──
  //
  // phaseInc는 16비트라 AVR에서 두 번에 나눠 써집니다(하위 바이트, 상위 바이트).
  // 그 사이에 ISR이 끼어들면 "새 하위 바이트 + 옛 상위 바이트"라는
  // 존재하지 않는 값으로 샘플이 계산됩니다.
  // volatile은 최적화만 막아줄 뿐 이 문제는 막아주지 못합니다.
  ATOMIC_BLOCK(ATOMIC_RESTORESTATE) {
    phase       = 0;            // 항상 중심값(128)에서 시작 → 시작할 때 "툭" 소리 없음
    phaseInc    = inc;
    speechState = SPEECH_TONE;  // 이 줄부터 ISR이 OCR1A를 갱신하기 시작합니다
  }
}


// ─────────────────────────────────────────────
// speechPlayDC() — 고정값 출력
// ─────────────────────────────────────────────
void speechPlayDC(uint8_t value) {
  // 순서가 중요합니다.
  // OCR1A를 먼저 쓰면, 상태를 바꾸기 전에 ISR이 끼어들어
  // 방금 쓴 값을 사인파 샘플로 덮어씁니다.
  // 그래서 "ISR을 멈춘다 → 값을 쓴다" 순서로 갑니다.
  ATOMIC_BLOCK(ATOMIC_RESTORESTATE) {
    speechState = SPEECH_DC;
    OCR1A       = value;
  }
}


// ─────────────────────────────────────────────
// speechStop() — 정지
// ─────────────────────────────────────────────
void speechStop() {
  ATOMIC_BLOCK(ATOMIC_RESTORESTATE) {
    speechState = SPEECH_STOPPED;
    phase       = 0;
    phaseInc    = 0;

    // 무음은 0이 아니라 128입니다.
    // 0으로 떨어뜨리면 듀티비가 50%에서 0%로 급변하면서
    // 스피커에서 "툭" 하는 잡음이 납니다.
    OCR1A = SPEECH_SILENCE;
  }

  // PWM(Timer1)과 샘플 인터럽트(Timer2)는 계속 돌려둡니다.
  // 매번 껐다 켜면 그 순간 핀 상태가 튀면서 잡음이 생깁니다.
}


// ─────────────────────────────────────────────
// speechIsPlaying()
// ─────────────────────────────────────────────
bool speechIsPlaying() {
  // 1바이트 읽기는 AVR에서 한 번에 처리되므로
  // 따로 인터럽트를 막을 필요가 없습니다.
  return speechState != SPEECH_STOPPED;
}


// ─────────────────────────────────────────────
// 샘플 인터럽트 — 125us마다 실행됩니다
//
// 여기에서 절대 하면 안 되는 것들:
//   Serial.print()  — 한 글자에 수백 사이클. 다음 인터럽트를 놓칩니다
//   delay()         — millis()가 인터럽트로 도는데 여기서 기다리면 멈춥니다
//   부동소수점 연산  — FPU가 없어서 수백 사이클
//   긴 반복문       — 125us 안에 못 끝내면 소리가 깨집니다
//
// 지금은 테이블 조회와 대입뿐입니다.
// ─────────────────────────────────────────────
ISR(TIMER2_COMPA_vect) {
  // 사인파 재생 중이 아니면 즉시 빠져나옵니다.
  // DC/정지 상태에서는 OCR1A를 건드리지 않아야
  // 메인이 써둔 값이 그대로 유지됩니다.
  if (speechState != SPEECH_TONE) {
    return;
  }

  phase += phaseInc;   // 16비트라 65536을 넘으면 알아서 0으로 돌아옵니다
                       // (사인파가 한 바퀴 돈 것과 정확히 같은 동작)

  // 상위 8비트만 꺼내 테이블 인덱스로 씁니다(0~255).
  // 하위 8비트는 소수부라 버립니다.
  OCR1A = pgm_read_byte(&SINE_TABLE[phase >> 8]);
}
